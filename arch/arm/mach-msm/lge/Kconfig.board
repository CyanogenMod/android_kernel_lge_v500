## arch/arm/mach-msm/lge/Kconfig.board
```kconfig
#
# Inlcude the specific Kconfig file for LGE board
#

# L05E
source "arch/arm/mach-msm/lge/L05E/Kconfig"

# J1V
source "arch/arm/mach-msm/lge/j1/Kconfig"

# GK
source "arch/arm/mach-msm/lge/gk/Kconfig"

# OMEGAR
source "arch/arm/mach-msm/lge/omegar/Kconfig"

# OMEGA
source "arch/arm/mach-msm/lge/omega/Kconfig"

# GV
source "arch/arm/mach-msm/lge/gv/Kconfig"

# GV KR
source "arch/arm/mach-msm/lge/gvkr/Kconfig"

# AWIFI
source "arch/arm/mach-msm/lge/awifi/Kconfig"

config MACH_LGE_DUMMY
	bool "NONE (No device)"
```

## arch/arm/mach-msm/lge/awifi/Kconfig
```kconfig
config BOARD_HEADER_FILE
	string "LGE board specific header file name"
	default ""

config MACH_APQ8064_GK_KR
	depends on ARCH_APQ8064
	select MACH_LGE
		bool "APQ8064 GK SKT KT LGU"
	help
	  Support for the LGE GK device.

config MACH_APQ8064_AWIFI
	depends on ARCH_APQ8064
	select MACH_LGE
		bool "APQ8064 A WiFi Only"
	help
	  Support for the LGE A WiFi only device.

config MACH_APQ8064_AWIFI070U
	depends on ARCH_APQ8064
	select MACH_LGE
		bool "APQ8064 A 070 Only"
	help
	  Support for the LGE A 070 only device.
```

## arch/arm/mach-msm/lge/gvar/Kconfig
```kconfig
config BOARD_HEADER_FILE
	string "LGE board specific header file name"
	default ""

config MACH_APQ8064_GVAR_CMCC
	depends on ARCH_APQ8064
	select MACH_LGE
		bool "APQ064 GVAR CMSS"
	help
	  Support for the LGE GVAR device.

config LGE_USB_DIAG_DISABLE
	default n
	bool "Disable diag function"
	help
	 Provide method of diag enable or disable

config RTC_PWROFF_ALARM
	default y
	bool "RTC pwroff alram set"
	help
	 Provide RTC power off alram
```
